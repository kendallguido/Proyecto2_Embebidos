## conf/bblayers.conf
```bitbake
# POKY_BBLAYERS_CONF_VERSION is increased each time build/conf/bblayers.conf
# changes incompatibly
POKY_BBLAYERS_CONF_VERSION = "2"

BBPATH = "${TOPDIR}"
BBFILES ?= ""

BBLAYERS ?= " \
  /home/bendicion/Sistema/poky/meta \
  /home/bendicion/Sistema/poky/meta-poky \
  /home/bendicion/Sistema/poky/meta-yocto-bsp \
  /home/bendicion/Sistema/poky/meta-raspberrypi \
  /home/bendicion/Sistema/poky/meta-openembedded/meta-oe \
  /home/bendicion/Sistema/poky/meta-openembedded/meta-multimedia \
  /home/bendicion/Sistema/poky/meta-openembedded/meta-networking \
  /home/bendicion/Sistema/poky/meta-openembedded/meta-python \
  "
```

## meta-proyecto2/conf/layer.conf
```bitbake
# We have a conf and classes directory, add to BBPATH
BBPATH .= ":${LAYERDIR}"

# We have recipes-* directories, add to BBFILES
BBFILES += "${LAYERDIR}/recipes-*/*.bb \
        	${LAYERDIR}/recipes-*/*/*.bbappend"

BBFILE_COLLECTIONS += "proyecto2"
BBFILE_PATTERN_proyecto2 = "^${LAYERDIR}/"
BBFILE_PRIORITY_proyecto2 = "5"
LAYERVERSION_proyecto2 = "4"
LAYERSERIES_COMPAT_proyecto2 = ""
```
